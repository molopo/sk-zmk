## boards/shields/sk/Kconfig.shield
```kconfig
# Copyright (c) 2020 Pete Johanson
# SPDX-License-Identifier: MIT

config SHIELD_SK_LEFT
    def_bool $(shields_list_contains,sk_left)

config SHIELD_SK_RIGHT
    def_bool $(shields_list_contains,sk_right)

config SHIELD_SK_DONGLE
    def_bool $(shields_list_contains,sk_dongle)
```
